#include "lahaina-cdp.dtsi"

&qupv3_se4_i2c {
	 st_fts@49 {
		st,x-flip = <1>;
		st,y-flip = <1>;
		fts,touch-follow-performance-def = <3>;
		fts,touch-follow-performance = <10 15 1
										8 15 1
										6 15 1
										4 15 1
										2 15 1>;
	 };
};
